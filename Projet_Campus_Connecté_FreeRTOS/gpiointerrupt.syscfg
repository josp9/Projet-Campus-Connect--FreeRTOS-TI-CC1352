/**
 * @cliArgs --board "/ti/boards/CC1352R1_LAUNCHXL" --rtos "freertos" --product "simplelink_cc13xx_cc26xx_sdk@7.10.02.23"
 * @versions {"tool":"1.16.2+3028"}
 */

/**
 * Import the modules used in this configuration.
 */
const FreeRTOS = scripting.addModule("/freertos/FreeRTOS");
const GPIO     = scripting.addModule("/ti/drivers/GPIO");
const GPIO1    = GPIO.addInstance();
const GPIO2    = GPIO.addInstance();
const GPIO3    = GPIO.addInstance();
const GPIO4    = GPIO.addInstance();
const I2C      = scripting.addModule("/ti/drivers/I2C", {}, false);
const I2C1     = I2C.addInstance();
const Power    = scripting.addModule("/ti/drivers/Power");
const Timer    = scripting.addModule("/ti/drivers/Timer", {}, false);
const Timer1   = Timer.addInstance();
const UART2    = scripting.addModule("/ti/drivers/UART2", {}, false);
const UART21   = UART2.addInstance();
const Settings = scripting.addModule("/ti/posix/freertos/Settings");

/**
 * Write custom configuration values to the imported modules.
 */
GPIO1.$hardware = system.deviceData.board.components["BTN-1"];
GPIO1.$name     = "CONFIG_GPIO_BUTTON_0";

GPIO2.$hardware = system.deviceData.board.components["BTN-2"];
GPIO2.$name     = "CONFIG_GPIO_BUTTON_1";

GPIO3.$hardware = system.deviceData.board.components.LED_RED;
GPIO3.$name     = "CONFIG_GPIO_LED_0";

GPIO4.$hardware = system.deviceData.board.components.LED_GREEN;
GPIO4.$name     = "CONFIG_GPIO_LED_1";

I2C1.$name              = "CONFIG_I2C_0";
I2C1.i2c.sdaPin.$assign = "boosterpack.10";
I2C1.i2c.sclPin.$assign = "boosterpack.9";

const CCFG              = scripting.addModule("/ti/devices/CCFG", {}, false);
CCFG.ccfgTemplate.$name = "ti_devices_CCFG_CCFGCC26XXTemplate0";

Timer1.$name               = "CONFIG_TIMER_0";
Timer1.timerInstance.$name = "CONFIG_GPTIMER_0";

UART21.$name = "CONFIG_UART2_0";

/**
 * Pinmux solution for unlocked pins/peripherals. This ensures that minor changes to the automatic solver in a future
 * version of the tool will not impact the pinmux you originally saw.  These lines can be completely deleted in order to
 * re-solve from scratch.
 */
GPIO1.gpioPin.$suggestSolution              = "boosterpack.13";
GPIO2.gpioPin.$suggestSolution              = "boosterpack.12";
GPIO3.gpioPin.$suggestSolution              = "boosterpack.39";
GPIO4.gpioPin.$suggestSolution              = "boosterpack.40";
I2C1.i2c.$suggestSolution                   = "I2C0";
Timer1.timerInstance.timer.$suggestSolution = "GPTM0";
UART21.uart.$suggestSolution                = "UART0";
UART21.uart.txPin.$suggestSolution          = "boosterpack.31";
UART21.uart.rxPin.$suggestSolution          = "boosterpack.32";
